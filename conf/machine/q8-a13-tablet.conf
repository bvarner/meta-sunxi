## conf/machine/q8-a13-tablet.conf
```bitbake
#@TYPE: Machine
#@NAME: Q8 A13 MID
#@DESCRIPTION: Machine configuration for A starndard Q8 style tablet device based on allwinner a13 CPU
#https://linux-sunxi.org/Q8

require conf/machine/include/sun5i.inc

KERNEL_DEVICETREE = "sun5i-a13-q8-tablet.dtb"
UBOOT_MACHINE = "q8_a13_tablet_defconfig"
SUNXI_FEX_FILE = "sys_config/a13/a13_mid.fex"
```
